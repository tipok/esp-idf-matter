## .github/configs/sdkconfig.defaults
```kconfig
# Increase a bit these stack sizes as they are too low by default
CONFIG_ESP_SYSTEM_EVENT_TASK_STACK_SIZE=4096

# For async-io (async-io-mini which is used by default does not need that)
#CONFIG_PTHREAD_TASK_STACK_SIZE_DEFAULT=8192

# Go figure...
CONFIG_FREERTOS_IDLE_TASK_STACKSIZE=4096

# BT
CONFIG_BT_BTC_TASK_STACK_SIZE=8192
CONFIG_BT_ENABLED=y
CONFIG_BT_BLUEDROID_ENABLED=y
CONFIG_BT_CLASSIC_ENABLED=n
CONFIG_BTDM_CTRL_MODE_BLE_ONLY=y
CONFIG_BTDM_CTRL_MODE_BR_EDR_ONLY=n
CONFIG_BTDM_CTRL_MODE_BTDM=n
CONFIG_BT_A2DP_ENABLE=n
CONFIG_BT_BLE_42_FEATURES_SUPPORTED=y
CONFIG_BT_BLE_50_FEATURES_SUPPORTED=n
CONFIG_BT_BLE_DYNAMIC_ENV_MEMORY=y

# Chips are RAM-tight with Thread+BLE+Matter; commissioning BLE needs a fraction of the default pool
CONFIG_BT_LE_ACL_BUF_COUNT=4          # 10 -> 4   (saves ~3.1 KiB)
CONFIG_BT_LE_HCI_EVT_HI_BUF_COUNT=8   # 30 -> 8   (saves ~5.7 KiB)
CONFIG_BT_LE_HCI_EVT_LO_BUF_COUNT=4   # 8 -> 4    (saves ~1.0 KiB)
CONFIG_BT_LE_MAX_CONNECTIONS=1        # 3 -> 1    (fewer conn state machines; conn_rsv_cnt -> 1)
CONFIG_BT_ACL_CONNECTIONS=1           # Bluedroid host: 4 -> 1

# Generic Thread functionality
CONFIG_OPENTHREAD_ENABLED=y

# Wifi/Thread + BLE coex
CONFIG_ESP_COEX_SW_COEXIST_ENABLE=y

# So that the QR code does not get distorted by misaligned log lines
CONFIG_LOG_TIMESTAMP_SOURCE_SYSTEM=y

# Colored terminal not enabled by default since ESP-IDF V5.5
CONFIG_LOG_COLORS=y
```
